## build-rpi/conf/bblayers.conf
```bitbake
# POKY_BBLAYERS_CONF_VERSION is increased each time build/conf/bblayers.conf
# changes incompatibly
POKY_BBLAYERS_CONF_VERSION = "2"

BBPATH = "${TOPDIR}"
BBFILES ?= ""

BBLAYERS ?= " \
  /home/devilfisher/yocto-rpi/poky/meta \
  /home/devilfisher/yocto-rpi/poky/meta-poky \
  /home/devilfisher/yocto-rpi/poky/meta-yocto-bsp \
  /home/devilfisher/yocto-rpi/meta-raspberrypi \
  /home/devilfisher/yocto-rpi/meta-openembedded/meta-oe \
  /home/devilfisher/yocto-rpi/meta-openembedded/meta-multimedia \
  /home/devilfisher/yocto-rpi/meta-openembedded/meta-networking \
  /home/devilfisher/yocto-rpi/meta-openembedded/meta-python \
  /home/devilfisher/yocto-rpi/meta-rauc \
  /home/devilfisher/yocto-rpi/meta-rauc-community/meta-rauc-raspberrypi \
  /home/devilfisher/yocto-rpi/meta-connman-custom \
  "
```
